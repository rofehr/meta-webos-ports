## meta-luneos-upstream/conf/layer.conf
```bitbake
BBPATH ?= ""
# We have a conf and classes directory, add to BBPATH
BBPATH .= ":${LAYERDIR}"
# We have recipe directories, add to BBFILES
BBFILES += "${LAYERDIR}/recipes-*/*/*.bb ${LAYERDIR}/recipes-*/*/*.bbappend"

BBFILE_COLLECTIONS += "meta-luneos-upstream"
BBFILE_PATTERN_meta-luneos-upstream := "^${LAYERDIR}/"
BBFILE_PRIORITY_meta-luneos-upstream = "10"

LAYERSERIES_COMPAT_meta-luneos-upstream = "warrior"
```
